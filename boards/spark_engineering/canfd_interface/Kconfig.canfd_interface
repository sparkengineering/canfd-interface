## boards/spark_engineering/canfd_interface/Kconfig.canfd_interface
```kconfig
# Copyright (c) 2021 Nordic Semiconductor ASA
# Copyright (c) 2024 Spark Engineering
# SPDX-License-Identifier: Apache-2.0

config BOARD_CANFD_INTERFACE
	select SOC_STM32G0B1XX
        select HAS_SEGGER_RTT if ZEPHYR_SEGGER_MODULE
```

## boards/spark_engineering/canfd_interface/board.yml
```yaml
# Copyright (c) 2024 Nordic Semiconductor ASA
# Copyright (c) 2024 Spark Engineering
# SPDX-License-Identifier: Apache-2.0

board:
  name: canfd_interface
  vendor: spark_engineering
  socs:
    - name: stm32g0b1xx
```

## boards/spark_engineering/canfd_interface/canfd_interface_defconfig
```kconfig
# Copyright (c) 2021 Nordic Semiconductor ASA
# Copyright (c) 2024 Spark Engineering
# SPDX-License-Identifier: Apache-2.0

CONFIG_ARM_MPU=y

CONFIG_GPIO=y

CONFIG_CLOCK_CONTROL=y

CONFIG_PINCTRL=y
```

## west.yml
```yaml
# Copyright (c) 2021 Nordic Semiconductor ASA
# Copyright (c) 2024 Spark Engineering
# SPDX-License-Identifier: Apache-2.0

manifest:
  remotes:
    - name: zephyrproject-rtos
      url-base: https://github.com/zephyrproject-rtos

  projects:
    - name: zephyr
      remote: zephyrproject-rtos
      revision: main
      import:
        # By using name-allowlist we can clone only the modules that are
        # strictly needed by the application.
        name-allowlist:
          - cmsis
          - hal_stm32
          - segger
          - mcuboot
          - tinycrypt
```
